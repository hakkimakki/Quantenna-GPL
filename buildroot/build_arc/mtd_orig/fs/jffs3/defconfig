## buildroot/build_arc/mtd_orig/fs/jffs3/defconfig
```kconfig
# JFFS2 Id: defconfig,v 1.1 2003/05/27 09:35:22 dwmw2  Exp
# $Id: defconfig,v 3.2 2004/12/09 16:09:09 dwmw2 Exp $

CONFIG_JFFS3_FS=m
ifdef NONAND
CONFIG_JFFS3_FS_NAND=n
else
CONFIG_JFFS3_FS_NAND=y
endif
```
